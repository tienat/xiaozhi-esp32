## components/app_network/Kconfig
```kconfig
menu "HCP network diagnostics"
    config HCP_WIFI_LOCAL_OVERRIDE
        bool "Connect using Wi-Fi credentials from local diagnostic header"
        default n
        help
            Explicit diagnostic override. Leave disabled for touch onboarding and
            to preserve the customer's saved Wi-Fi network.
endmenu
```

## components/app_ui/Kconfig
```kconfig
config HCP_ONBOARDING_WIDGETS
    bool
    default y if BOARD_TYPE_CUSTOM_HCP_P4
    select LV_USE_KEYBOARD
    select LV_USE_SPINNER
    help
        Widgets required for the touch-based HCP onboarding flow.
```
